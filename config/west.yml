## config/west.yml
```yaml
manifest:
  remotes:
    - name: zmkfirmware
      url-base: https://github.com/zmkfirmware
    - name: andrewjrae
      url-base: https://github.com/andrewjrae
  projects:
    - name: zmk
      remote: zmkfirmware #andrewjrae
      revision: main #min-prior-ms
      import: app/west.yml
  self:
    path: config
```
